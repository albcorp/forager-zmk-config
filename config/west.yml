## config/west.yml
```yaml
manifest:
  defaults:
    revision: v0.3
  remotes:
    - name: zmkfirmware
      url-base: https://github.com/zmkfirmware
    - name: carrefinho
      url-base: https://github.com/carrefinho
    - name: caksoylar
      url-base: https://github.com/caksoylar
  projects:
    - name: zmk
      remote: zmkfirmware
      import: app/west.yml
    - name: forager-zmk-module
      remote: carrefinho
    - name: zmk-rgbled-widget
      remote: caksoylar
  self:
    path: config
```
